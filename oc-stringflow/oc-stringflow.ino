#include <FastLED.h>

// マトリックスのサイズ
#define MATRIX_WIDTH 32
#define MATRIX_HEIGHT 8

// データピン
#define DATA_PIN 6

// LED配列を定義
CRGB leds[MATRIX_WIDTH * MATRIX_HEIGHT];

// 文字を定義（5x7のドットマトリックスフォント）
const uint8_t font[96][5] = {
  { 0b00000000, 0b00000000, 0b00000000, 0b00000000, 0b00000000 },  // space
  { 0b00000000, 0b00000000, 0b01001111, 0b00000000, 0b00000000 },  // !
  { 0b00000000, 0b00000111, 0b00000000, 0b00000111, 0b00000000 },  // "
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  { 0b00001000, 0b00000100, 0b00000100, 0b00001000, 0b00000100 }   // ~
};

const CRGB colary[] = { CRGB::BlueViolet, CRGB::Chartreuse, CRGB::Cyan };

void setup() {
  FastLED.addLeds<NEOPIXEL, DATA_PIN>(leds, MATRIX_WIDTH * MATRIX_HEIGHT);
  FastLED.clear();
  Serial.begin(115200);
}

int scrollPos = MATRIX_WIDTH;
CRGB color = CRGB::Red;

void loop() {
  // テキストを定義
  const char* text = "Welcome to the Shikidalab!";

  // マトリックスをクリア
  FastLED.clear();

  // テキストを描画
  for (int i = 0; i < strlen(text); i++) {
    drawChar(scrollPos + i * 6, 0, text[i], color);
  }

  // 画面を更新
  FastLED.show();

  // スクロール位置を更新
  scrollPos--;

  // テキストがすべてスクロールしたらリセット
  if (scrollPos < -(int)strlen(text) * 6) {
    scrollPos = MATRIX_WIDTH;
    color = colary[random(3)];
  }
  //Serial.println(-(int)strlen(text) * 6);
  // スクロール速度を調整
  delay(100);
}

// 文字を描画する関数
void drawChar(int x, int y, char c, CRGB color) {
  if (c < 32 || c > 127) return;  // 無効な文字をスキップ
  for (int i = 0; i < 5; i++) {
    uint8_t line = font[c - 32][i];
    for (int j = 0; j < 8; j++) {
      if (line & 0x1) {
        setPixel(x + i, y + j, color);
      }
      line >>= 1;
    }
  }
  // Serial.print(x);
  // Serial.print(" ");
  // Serial.println(y);
}

// ピクセルを設定する関数
void setPixel(int x, int y, CRGB color) {
  // Serial.print(x);
  // Serial.print(" ");
  // Serial.println(y);
  if (x < 0 || x >= MATRIX_WIDTH || y < 0 || y >= MATRIX_HEIGHT) return;
  int index = y + x * MATRIX_HEIGHT;
  if (index / MATRIX_HEIGHT % 2 != 0) index = (((index + MATRIX_HEIGHT) / MATRIX_HEIGHT) * MATRIX_HEIGHT) - index % MATRIX_HEIGHT - 1;
  leds[index] = color;
  Serial.println(index);
}
